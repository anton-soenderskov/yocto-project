## meta-customlayer/conf/layer.conf
```bitbake
# We have a conf and classes directory, add to BBPATH
BBPATH .= ":${LAYERDIR}"

# We have recipes-* directories, add to BBFILES
BBFILES += "${LAYERDIR}/recipes-*/*/*.bb \
            ${LAYERDIR}/recipes-*/*/*.bbappend"

BBFILE_COLLECTIONS += "meta-customlayer"
BBFILE_PATTERN_meta-customlayer = "^${LAYERDIR}/"

# Set a higher priority for your custom layer
BBFILE_PRIORITY_meta-customlayer = "7"

LAYERDEPENDS_meta-customlayer = "core"
LAYERSERIES_COMPAT_meta-customlayer = "walnascar"

# Set preferred Go version
PREFERRED_VERSION_go = "1.24.6"
PREFERRED_PROVIDER_go = "go-runtime"
```
